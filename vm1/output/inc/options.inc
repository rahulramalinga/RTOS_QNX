#define __OPT_AARCH64_VERSION__ 8
#define OPT_AARCH64_VERSION_8
#define __OPT_ABLELOCK__ yes
#define OPT_ABLELOCK_yes
#define __OPT_ARCH__ x86_64
#define OPT_ARCH_x86_64
#define __OPT_ASLR__ yes
#define OPT_ASLR_yes
#define __OPT_ASSUMED_IP__ none
#define OPT_ASSUMED_IP_none
#define __OPT_BOOT_SIZE__ 0
#define OPT_BOOT_SIZE_0
#define __OPT_BUILD__ all
#define OPT_BUILD_all
#define __OPT_CERTICOM__ no
#define OPT_CERTICOM_no
#define __OPT_COPY__ all
#define OPT_COPY_all
#define __OPT_COPY_DEST__ none
#define OPT_COPY_DEST_none
#define __OPT_CPU__ 2
#define OPT_CPU_2
#define __OPT_CRYPTODEV__ no
#define OPT_CRYPTODEV_no
#define __OPT_DATA_INODES__ 3000
#define OPT_DATA_INODES_3000
#define __OPT_DATA_SIZE__ 60
#define OPT_DATA_SIZE_60
#define __OPT_EXTRA_DIRS__ none
#define OPT_EXTRA_DIRS_none
#define __OPT_GRAPHICS__ yes
#define OPT_GRAPHICS_yes
#define __OPT_GUEST__ none
#define OPT_GUEST_none
#define __OPT_HOSTNAME__ vm1
#define OPT_HOSTNAME_vm1
#define __OPT_IO_SOCK_DIAG__ no
#define OPT_IO_SOCK_DIAG_no
#define __OPT_IP__ dhcp
#define OPT_IP_dhcp
#define __OPT_MACADDR__ 52:54:00:63:69:92
#define __OPT_NFS__ no
#define OPT_NFS_no
#define __OPT_PART_SIZES__ full
#define OPT_PART_SIZES_full
#define __OPT_PATHTRUST__ no
#define OPT_PATHTRUST_no
#define __OPT_PERL__ no
#define OPT_PERL_no
#define __OPT_PKCS11__ no
#define OPT_PKCS11_no
#define __OPT_POLICY__ none
#define OPT_POLICY_none
#define __OPT_PROC__ no
#define OPT_PROC_no
#define __OPT_PYTHON__ no
#define OPT_PYTHON_no
#define __OPT_QAUDIT__ no
#define OPT_QAUDIT_no
#define __OPT_QCFS__ no
#define OPT_QCFS_no
#define __OPT_QFIM__ no
#define OPT_QFIM_no
#define __OPT_QH_CONFIG__ no
#define OPT_QH_CONFIG_no
#define __OPT_QTD__ no
#define OPT_QTD_no
#define __OPT_QTSAFEFS__ no
#define OPT_QTSAFEFS_no
#define __OPT_QVM__ no
#define OPT_QVM_no
#define __OPT_RAM__ 1G
#define OPT_RAM_1G
#define __OPT_REPOS__ /cygdrive/C//Users/yoy91/qnx800/target/qnx
#define __OPT_ROOT__ no
#define OPT_ROOT_no
#define __OPT_SANITIZERS__ no
#define OPT_SANITIZERS_no
#define __OPT_SECPOL__ no
#define OPT_SECPOL_no
#define __OPT_SECURE_DATA__ no
#define OPT_SECURE_DATA_no
#define __OPT_SECURE_PROCFS__ yes
#define OPT_SECURE_PROCFS_yes
#define __OPT_SLM__ no
#define OPT_SLM_no
#define __OPT_SSHD_PREGEN__ yes
#define OPT_SSHD_PREGEN_yes
#define __OPT_SSH_IDENT__ prompt
#define OPT_SSH_IDENT_prompt
#define __OPT_SYS_INODES__ 1000
#define OPT_SYS_INODES_1000
#define __OPT_SYS_SIZE__ 20
#define OPT_SYS_SIZE_20
#define __OPT_TCG__ no
#define OPT_TCG_no
#define __OPT_TIME_SERVERS__ pool.ntp.org
#define OPT_TIME_SERVERS_pool_ntp_org
#define __OPT_TOMCRYPT__ no
#define OPT_TOMCRYPT_no
#define __OPT_TYPE__ vmware
#define OPT_TYPE_vmware
#define __OPT_TZ__ UTC0
#define OPT_TZ_UTC0
#define __OPT_UNION__ yes
#define OPT_UNION_yes
#define __OPT_UPDATE__ all
#define OPT_UPDATE_all
#define __OPT_USB__ yes
#define OPT_USB_yes
#define __OPT_USERS__ root:qnxuser:user1:user2:user3:user4:user5:user6
#define __OPT_VALGRIND__ no
#define OPT_VALGRIND_no
#define __OPT_VERBOSE__ no
#define OPT_VERBOSE_no
#define __OPT_ZONEINFO__ no
#define OPT_ZONEINFO_no
#define __HOSTNAME__  vm1
#define __IMAGE_TYPE__  bios
#define IMAGE_TYPE_bios
